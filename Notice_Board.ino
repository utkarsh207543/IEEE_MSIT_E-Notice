#include <SPI.h>
#include <SD.h>
#include "LedControl.h"
#include <SoftwareSerial.h>

int MatrixNumber = 8;
char incomingByte;
char Buffer[2000];
char Buffer_inverse[2000];
LedControl lc = LedControl(12, 11, 10, MatrixNumber);
const int chipSelect = 53;
File myFile;
int length;
char a, b;
char phrase[1000];
bool flag = 1;
bool latch = 1;
int z = 0;

int fontDefinitions[480] = {
	0x00,0x00,0x00,0x00,0x00,/*space*/ // is 32 in ASCII
	0x00,0xF6,0xF6,0x00,0x00,/*!*/
	0x00,0xE0,0x00,0xE0,0x00,/*"*/
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	0x00,0x00,0x06,0x06,0x00,/*.*/
	0x02,0x0C,0x10,0x60,0x80,/*/*/
	0x7C,0x8A,0x92,0xA2,0x7C,/*0*/
	0x00,0x42,0xFE,0x02,0x00,/*1*/
	0x42,0x86,0x8A,0x92,0x62,/*2*/
	0x44,0x82,0x92,0x92,0x6C,/*3*/
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	0x08,0x10,0x18,0x08,0x10/*~*/
};

void BufferBuilding(char * stringToDisplay, byte stringLength)
{
	int i = 0;

	//loop on every characters (on the string)
	for (int k = 0; k < stringLength; k++) {
		//here we call the characters library  
		int caract = k;
		Buffer[i + 0] = fontDefinitions[((stringToDisplay[caract] - 32) * 5) + 0];
		Buffer[i + 1] = fontDefinitions[((stringToDisplay[caract] - 32) * 5) + 1];
		Buffer[i + 2] = fontDefinitions[((stringToDisplay[caract] - 32) * 5) + 2];
		Buffer[i + 3] = fontDefinitions[((stringToDisplay[caract] - 32) * 5) + 3];
		Buffer[i + 4] = fontDefinitions[((stringToDisplay[caract] - 32) * 5) + 4];
		Buffer[i + 5] = B00000000;  //one blank column of leds between two characters
		i = i + 6;
	}

	// here, we create a second buffer, to display the message on the switched matrixes
	for (int k = 0; k < stringLength * 6; k++) {
		for (int i = 0; i < 8; i++) {
			bitWrite(Buffer_inverse[k], i, bitRead(Buffer[k], 7 - i));
		}
	}
}

void DrawText(byte stringLength) {

	for (int k = 0; k < stringLength * 6; k++) {


		for (int m = 0; m < MatrixNumber; m++) {
			if (m % 2 == 0) //check is the module is upside-down or not...
			{
				//here, the matrix is flipped upside-down                
				for (int i = 0; i < 8; i++) {  //loop on the columns

					lc.setRow(m, 7 - i, Buffer[i + k + 8 * m]);
				}
			}
			else
			{
				//classical   
				for (int i = 0; i < 8; i++) {  //loop on the columns


					lc.setRow(m, i, Buffer_inverse[i + k + 8 * m]);
				}
			}
		}
	}

}

void setup() {

	Serial1.begin(9600);
	Serial1.println("Write Something to file.");
	SD.begin(chipSelect);

	if (SD.exists("GOOGLE.TXT"))
	{
		myFile = SD.open("GOOGLE.TXT");

		while (myFile.available())
		{
			//Serial1.write(myFile.read());
			phrase[z] = myFile.read();
			z++;
		}
		myFile.close();
	}

	Serial1.println(phrase);

	//matrix modules init
	for (int adresse = 0; adresse<MatrixNumber; adresse++) {
		/*The MAX72XX is in power-saving mode on startup*/
		lc.shutdown(adresse, false);
		/* Set the brightness to a medium values */
		lc.setIntensity(adresse, 4);
		/* and clear the display */
		lc.clearDisplay(adresse);
	}

	BufferBuilding(phrase, z);

	Serial1.println("Hi ! I'm waiting for a message.");

}

void loop()
{

	DrawText(z);
	if (Serial1.available())
	{

		myFile = SD.open("GOOGLE.TXT", FILE_WRITE);
		length = Serial1.available();
		for (int i = 0; i < length; i++)
		{
			a = Serial1.read();
			myFile.print(a);
			if (a == '~')
			{
				myFile.close();
				if (SD.exists("GOOGLE.TXT"))
				{
					SD.remove("GOOGLE.TXT");
					Serial1.println("ReWrite");


				}
			}


		}

		myFile.close();
		Serial1.println("Writing Complete!");


		asm volatile ("  jmp 0");

	}


}
